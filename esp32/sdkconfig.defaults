## esp32/sdkconfig.defaults
```kconfig
CONFIG_IDF_TARGET="esp32s3"
CONFIG_SPIRAM=y
CONFIG_SPIRAM_MODE_OCT=y
CONFIG_PARTITION_TABLE_CUSTOM=y
CONFIG_ESPTOOLPY_FLASHSIZE_8MB=y

CONFIG_ESP32_CAMERA_ALLOC_FROM_SPIRAM_FIRST=y
CONFIG_BT_ENABLED=n
CONFIG_ESP_WIFI_ENABLED=n
CONFIG_ETH_ENABLED=n
CONFIG_ESP_NETIF_TCPIP_LWIP=n
CONFIG_ESP_ERR_TO_NAME_LOOKUP=n
CONFIG_ESP_PHY_ENABLED=y
CONFIG_COMPILER_OPTIMIZATION_PERF=y
CONFIG_ESP32S3_DEFAULT_CPU_FREQ_MHZ=240
CONFIG_SPIRAM_SPEED_80M=y
```
